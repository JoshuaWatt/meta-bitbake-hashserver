## conf/layer.conf
```bitbake
# We have a conf and classes directory, add to BBPATH
BBPATH .= ":${LAYERDIR}"
# We have recipes-* directories, add to BBFILES
BBFILES += "${LAYERDIR}/recipes-*/*/*.bb"

BBFILE_COLLECTIONS += "bitbake-hashserver"
BBFILE_PATTERN_bitbake-hashserver = "^${LAYERDIR}/"
BBFILE_PRIORITY_bitbake-hashserver = "5"

# This should only be incremented on significant changes that will
# cause compatibility issues with other layers
LAYERVERSION_bitbake-hashserver = "1"
LAYERSERIES_COMPAT_bitbake-hashserver = "nanbield"
LAYERDEPENDS_bitbake-hashserver = " \
    core \
    meta-python \
    virtualization-layer \
"
```
